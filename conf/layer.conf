## conf/machine/myboard.conf
```bitbake
MACHINE_FEATURES:remove = "efi"
MACHINE_FEATURES += "pcbios"
PREFERRED_PROVIDER_virtual/bootloader = "grub"
```

## files/wic/myboard-cfast.wks
```
part /boot --source bootimg-pcbios --sourceparams="loader-bios=grub" --ondisk sda --label boot --active --align 1024 --fixed-size 64M

part / --source rootfs --ondisk sda --fstype=ext4 --label rootfs --align 1024

part /data --ondisk sda --fstype=ext4 --label data --align 1024 --fixed-size 512M

bootloader --ptable msdos --source bootimg-pcbios --timeout=3 --append="rootwait console=ttyS0,115200 quiet i915.enable_rc6=0"
```
